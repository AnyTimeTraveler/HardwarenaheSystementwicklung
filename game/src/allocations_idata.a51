NAME allocations_idata


; ==============
; == DATA RAM ==
; ==============

SEG_STACK SEGMENT DATA

PUBLIC STACK

RSEG SEG_STACK
STACK:                      DS 0x10

SEG_BITS SEGMENT BIT

PUBLIC BIT_KEYBOARD_BREAK, BIT_CURRENT_COLOR, BIT_RUN_GAMETICK

RSEG SEG_BITS
BIT_KEYBOARD_BREAK:         DBIT 1
BIT_CURRENT_COLOR:          DBIT 1
BIT_RUN_GAMETICK:           DBIT 1
BIT_MULTI_SCREEN_MODE:      DBIT 1


SEG_CURRENT_PIECE_DATA SEGMENT DATA

PUBLIC CURRENT_PIECE_DECOMPRESSED, CP
PUBLIC CP_R0_L, CP_R0_ML, CP_R0_MR, CP_R0_R
PUBLIC CP_R1_L, CP_R1_ML, CP_R1_MR, CP_R1_R
PUBLIC CP_R2_L, CP_R2_ML, CP_R2_MR, CP_R2_R
PUBLIC CP_R3_L, CP_R3_ML, CP_R3_MR, CP_R3_R

RSEG SEG_CURRENT_PIECE_DATA
CURRENT_PIECE_DECOMPRESSED: DS 16

CP                          DATA CURRENT_PIECE_DECOMPRESSED
CP_R0_L                     DATA CP + 0
CP_R0_ML                    DATA CP + 1
CP_R0_MR                    DATA CP + 2
CP_R0_R                     DATA CP + 3

CP_R1_L                     DATA CP + 4
CP_R1_ML                    DATA CP + 5
CP_R1_MR                    DATA CP + 6
CP_R1_R                     DATA CP + 7

CP_R2_L                     DATA CP + 8
CP_R2_ML                    DATA CP + 9
CP_R2_MR                    DATA CP + 10
CP_R2_R                     DATA CP + 11

CP_R3_L                     DATA CP + 12
CP_R3_ML                    DATA CP + 13
CP_R3_MR                    DATA CP + 14
CP_R3_R                     DATA CP + 15

CURRENT_PIECE_LENGTH        EQU  16


SEG_VARIABLES SEGMENT DATA

PUBLIC GAMETICK_SUB_COUNTER, CURRENT_LEVEL, CURRENT_PIECE_INDEX, CURRENT_PIECE_ROT_INDEX, CURRENT_PIECE_V_POS
PUBLIC CURRENT_PIECE_H_POS, SCREEN_REFRESH_CURRENT_ROW, GAMESTATE, SCREENMODE, CLEARING_ROW

RSEG SEG_VARIABLES
GAMETICK_SUB_COUNTER:       DS 1
CURRENT_LEVEL:              DS 1
CURRENT_PIECE_INDEX:        DS 1
CURRENT_PIECE_ROT_INDEX:    DS 1
CURRENT_PIECE_V_POS:        DS 1
CURRENT_PIECE_H_POS:        DS 1
SCREEN_REFRESH_CURRENT_ROW: DS 1
GAMESTATE:                  DS 1
SCREENMODE:                 DS 1
CLEARING_ROW:               DS 1
ANIMATION_INDEX:            DS 1


; ===============
; == IDATA SFR ==
; ===============

PUBLIC T2CON, RCAP2L, RCAP2H, TL2, TH2
PUBLIC OUT_CLK, OUT_DATA, OUT_GAMETICK, OUT_SCREEN, OUT_KEYBOARD, IN_KEYBOARD_DATA, OUT_LED

T2CON                       DATA 0xC8
RCAP2L                      DATA 0xCA
RCAP2H                      DATA 0xCB
TL2                         DATA 0xCC
TH2                         DATA 0xCD
OUT_CLK                     BIT P1.0
OUT_DATA                    BIT P1.1
OUT_GAMETICK                BIT P1.2
OUT_SCREEN                  BIT P1.3
OUT_KEYBOARD                BIT P1.4
IN_KEYBOARD_DATA            BIT P3.2
OUT_LED                     BIT P3.5


; ===============
; == IDATA RAM ==
; ===============

PUBLIC GAMESCREEN, GAMESCREEN_LEN, GAMESCREEN_ROWS, GAMESCREEN_ROW_LEN

GAMESCREEN_LEN            EQU 0xC0
GAMESCREEN_ROWS           EQU 0x30
GAMESCREEN_ROW_LEN        EQU 0x04

ISEG AT 0x40
GAMESCREEN:               DS 0xC0

END
